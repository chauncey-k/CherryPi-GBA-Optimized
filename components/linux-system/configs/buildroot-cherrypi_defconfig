## components/linux-system/configs/buildroot-cherrypi_defconfig
```kconfig
BR2_arm=y
BR2_arm926t=y
BR2_ARM_EABI=y
BR2_TOOLCHAIN_EXTERNAL=y
BR2_TOOLCHAIN_EXTERNAL_BOOTLIN=y
BR2_TOOLCHAIN_EXTERNAL_BOOTLIN_ARMV5_EABI_MUSL_STABLE=y
BR2_TARGET_GENERIC_HOSTNAME="cherrypi-proto"
BR2_TARGET_GENERIC_ISSUE="Cherry Pi prototype - serial bring-up"
BR2_TARGET_GENERIC_ROOT_PASSWD="cherrypi"
BR2_TARGET_GENERIC_GETTY_PORT="ttyS0"
BR2_TARGET_GENERIC_GETTY_BAUDRATE_115200=y
BR2_SYSTEM_DHCP=""
BR2_TARGET_ROOTFS_EXT2=y
BR2_TARGET_ROOTFS_EXT2_4=y
BR2_TARGET_ROOTFS_EXT2_SIZE="256M"
BR2_TARGET_ROOTFS_EXT2_LABEL="rootfs"
BR2_TARGET_ROOTFS_EXT2_MKFS_OPTIONS="-O ^64bit,^metadata_csum,^orphan_file"
# BR2_TARGET_ROOTFS_TAR is not set
BR2_PACKAGE_HOST_GENIMAGE=y
BR2_PACKAGE_HOST_DOSFSTOOLS=y
BR2_PACKAGE_HOST_MTOOLS=y

BR2_ROOTFS_POST_BUILD_SCRIPT="@SYSTEM_ROOT@/board/cherrypi/post-build.sh"
```
